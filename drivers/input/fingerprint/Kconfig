## drivers/input/fingerprint/Kconfig
```kconfig
menu "Fingerprint Drivers"

source "drivers/input/fingerprint/fpc1020/Kconfig"
source "drivers/input/fingerprint/goodix/Kconfig"

endmenu
```

## drivers/input/fingerprint/fpc1020/Kconfig
```kconfig
config FINGERPRINT_FPC1020
        tristate "FPC1020 fingerprint driver support"
        help
          say Y here to enable fpc1020 fingerprint driver support!
```

## drivers/input/fingerprint/gf3258/Kconfig
```kconfig
config FINGERPRINT_GF3258
	tristate "goodix fingerprint gf3258"
	help 
		say Y to enable gf3258 goodix
```

## drivers/input/fingerprint/goodix/Kconfig
```kconfig
config FINGERPRINT_GF3208
	tristate "goodix fingerprint gf3208"
	help
		say Y to enable gf3208 goodix

config FINGERPRINT_GF3258
	tristate "goodix fingerprint gf3258"
	help
		say Y to enable gf3258 goodix

config FINGERPRINT_GOODIX_TA
	tristate "Finger print card goodix"
	help
	  Say Y here to enable support for retrieving self-test reports.
	  If unsure, say N.
	  To compile this driver as a module, choose M here.
```

## drivers/input/touchscreen/focal_ft8719_d2t/Kconfig
```kconfig
#
# Focaltech Touchscreen driver configuration
#

config TOUCHSCREEN_FOCAL_FT8719_D2T
	bool "Focaltech Touchscreen"
	depends on I2C
	default n
	help
	  Say Y here if you have Focaltech touch panel.
	  If unsure, say N.
```

## drivers/input/touchscreen/focal_ft8719_e7t/Kconfig
```kconfig
#
# Focaltech Touchscreen driver configuration
#

config TOUCHSCREEN_FOCAL_FT8719_E7T
	bool "Focaltech Touchscreen"
	depends on I2C
	default n
	help
	  Say Y here if you have Focaltech touch panel.
	  If unsure, say N.
```

## drivers/input/touchscreen/nvt_touch_d2t/Kconfig
```kconfig
#
# Novatek NT36xxx touchscreen driver configuration
#

config TOUCHSCREEN_NVT_D2T
	tristate "Novatek NT36xxx"
	help
	  Say Y here if you have a Novatek NT36xxx touchscreen connected
	  to your system.

	  If unsure, say N.
```

## drivers/platform/xiaomi/Kconfig
```kconfig
# Xiaomi configuration options

config MACH_XIAOMI
	bool "Xiaomi device"
	depends on ARCH_QCOM
	help
	  Support for Xiaomi products

config MACH_XIAOMI_SDM660
	bool "Xiaomi SDM660"
	depends on ARCH_QCOM
	select MACH_XIAOMI
	help
	  Support for Xiaomi SDM660 devices

menu "Xiaomi board selection"

	config MACH_MI
		bool "Mi board"
		select MACH_XIAOMI_SDM660
		help
		  Support for Mi boards

	config MACH_XIAOMI_JASON
		bool "Xiaomi jason board"
		select MACH_MI
		help
		  Support for Xiaomi Mi Note 3

	config MACH_LONGCHEER
		bool "Longcheer board"
		select MACH_XIAOMI_SDM660
		help
		  Support for Longcheer boards

	config MACH_XIAOMI_LAVENDER
		bool "Xiaomi lavender board"
		select MACH_LONGCHEER
		help
		  Support for Xiaomi Redmi Note 7

	config MACH_XIAOMI_TULIP
		bool "Xiaomi tulip board"
		select MACH_LONGCHEER
		help
		  Support for Xiaomi Redmi Note 6 Pro

	config MACH_XIAOMI_WHYRED
		bool "Xiaomi whyred board"
		select MACH_LONGCHEER
		help
		  Support for Xiaomi Redmi Note 5 (Pro)

	config MACH_XIAOMI_WAYNE
		bool "Xiaomi wayne board"
		select MACH_LONGCHEER
		help
		  Support for Xiaomi MI 6X variant

endmenu
```
